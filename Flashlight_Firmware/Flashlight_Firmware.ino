/*
Rear Bike Light - Alternative firmware for 2 LEDs

* Author: Stanislav (GitHub: https://github.com/Stanislav-developer || Youtube: https://www.youtube.com/@TehnoMaisterna)
* За основу взятий код оригінальної прошивки firmware_3 з репозиторію: https://github.com/Stanislav-developer/Rear_Bike_Light
* Date: 22-07-2025
* Ліцензія: MIT License – проєкт відкритий, вільно використовуй з зазначенням автора 

* Modified version: V1.0
  Функціонал:
  * Зміна яскравості в 3 ступені для 2 світлодіодів(всього 6 режимів)

* Опис:

  Це модифікована прошивка для ліхтарика з 2 вихідними pwm сигнала для керування 2 світлодіодами незалежно, призначена для мікроконтролера ATtiny13/ATtiny13A
  Що змінено від оригінальної прошивки:
  1.Переривання з INT0 переніс на PCINT
  2.Доданий ще один керуючий pwm вихід
  3.Роботу з EEPROM тепер реалізував за допомогою стандартної бібліотеки.

  Реалізує такий функціонал:

    1.Вкл/викл ліхтарик коротким нажаттям на кнопку

    2.Обробка довгого та короткого нажаття на кнопку та фільтрація дребезгу контактів

    3.Довге нажаття на кнопку(>1сек) включає наступний режим зі списку:
      1.Максимальна яскравість 1 світлодіоду (Споживання: 350 мА)
      2.Середня яскравість 1 світлодіоду(Споживання: ~150 мА)
      3.Мінімальна яскравість 1 світлодіоду (Споживання: ~40 мА)
      4.Максимальна яскравість 2 світлодіоду (Споживання: 350 мА)
      5.Середня яскравість 2 світлодіоду(Споживання: ~150 мА)
      6.Мінімальна яскравість 2 світлодіоду (Споживання: ~40 мА)
      *Показники споживання можуть відрізнятися якщо ви використаєте іншу мікросхему LED драйвера.

    4.Збереження останнього вибраного режиму у енергонезалежну EEPROM память
      Вам не доведеться постійно перемикати всі режими щоб включити якийсь конкретний.
      Після виключення ліхтарика останній вибраний режим зберігається у енергонезалежну EEPROM память та при наступному включенні ліхтарика активується останній вибраний вами режим

    5.Реалізована функція SleepMode:
      Коли ліхтарик виключений, ATtiny13 активує переривання на піні PCINT2 та переходить у режим сну (SLEEP_PWR_DOWN).
      Споживання у режимі сну близько 0,00003 А тобто 30 мікроАмпер що дуже мало! Потрібно близько 5 років щоб повністю розрядити акумулятор 1Ah при такому режимі)

* Конфігурація пінів:
  5 пін(PB0) - керуючий вихідний pwm для 2 світлодіоду
  6 пін(PB1) - керуючий вихідний pwm для 2 світлодіоду
  7 пін(PB2) - вхід для тактової кнопки з підтяжкою до VCC та перериванням PCINT2

*/

// ПІДКЛЮЧЕННЯ БІБЛІОТЕК
#include <avr/sleep.h> // Підключаємо бібліотеку для роботи з sleep_mode
#include <EEPROM.h> // Підключаємо бібліотеку для роботи з EEPROM

// ПРИВЯЗКА ПІНІВ
#define butPin 2 // 7 Пін кнопки (PB2)
#define ledPin 0 // 5 Пін виходу pwm (PB0)
#define ledPin2 1 // 6 Пін виходу pwm (PB1)

// ОГОЛОШЕННЯ ЗМІННИХ

//Обробка кнопки:
#define debounceInterval 50 // Інтервал для фільтрації дребезгу контактів кнопки. За потреби (наприклад, при неякісній кнопці) збільшіть значення
#define buttonLongPressDuration 800 // Час, після якого програма сприймає натискання кнопки як довге
bool previousStateButton = LOW; // Попередній стан кнопки (По дефолту не натиснута)
bool longPressState = false; // Стан довгого натиску (По дефолту FALSE)
unsigned long buttonLastPress; // Запамятовує момент коли кнопку натиснули(Час останнього натискання кнопки)
unsigned long previousButtonMillis; // Запамятовує час останнього зчитування стану кнопки з урахуванням debounceInterval
unsigned long buttonPressDuration; // Зберігає данні про те скільки часу кнопка утримується

// LightMode
byte lightMode = 6; // Зберігає номер поточного режиму світіння (По дефолту це 6 режим, світлодіод не світить)
#define EEPROM_ADDR 0 // Оголошуємо адрес eeprom памяті куди зберігатиметься змінна lightMode

// sleep_mode
volatile bool sleepState = true; // Показує чи перебуває мікроконтролер у режимі сну, якщо true - спить, якщо false - працює
volatile bool isFirstPress = false; // Показує чи було вже перше коротке або довге натискання перед сном, ця змінна потрібна для коректної обробки кнопки після виходу мікроконтролера з режиму сну

// ОСНОВНИЙ БЛОК КОДУ

void setup() {
  pinMode(butPin, INPUT_PULLUP); // Оголошуємо butPin як вхід з підтяжкою до VCC !Сигнал з кнопки інвертований
  pinMode(ledPin, OUTPUT); 

  MCUCR|= 1<<SE; // Вмикаємо можливість переходу в режим сну, те саме що sleep_enable()
  MCUCR|=(1<<SM1) | (0<<SM0); // Задаємо режим сну: "SLEEP_MODE_PWR_DOWN" самий економний режим сну (споживання ~30мкА)
  
  GIMSK|= 1<<PCIE; // Дозволяємо переривання PCINT
  PCMSK|= 1<<PCINT2; // Вмикаємо переривання PCINT2 на 7 піні(PB2), переривання спрацьовує коли на піні зявляється LOW (низький рівень сигналу)
  sei(); // Дозволяємо глобальні переривання, насправді це не обовязково писати, але йой най буде)
}

// Попередній приклад роботи з EEPROM
// Функція читання з EEPROM
// uint8_t eeprom_read(uint8_t addr) {
//   while (EECR & (1 << EEPE));     // Чекаємо завершення попереднього запису
//   EEAR = addr;                    // Записуємо адресу у регістр адреси EEPROM
//   EECR |= (1 << EERE);            // Запускаємо операцію читання з EEPROM
//   return EEDR;                    // Повертаємо прочитане значення з регістру даних EEPROM
// }

// Функція запису в EEPROM
// void eeprom_write(uint8_t addr, uint8_t data) {
//   while (EECR & (1 << EEPE));     // Чекаємо, поки завершиться попередній запис
//   EEAR = addr;                    // Встановлюємо адресу EEPROM, куди будемо записувати
//   EEDR = data;                    // Записуємо байт даних у регістр даних EEPROM
//   EECR |= (1 << EEMPE);           // Встановлюємо дозвіл на запис
//   EECR |= (1 << EEPE);            // Виконуємо запис
// }

// Функція обробника кнопки
void buttonProcessing() {
  
  if(millis() - previousButtonMillis > debounceInterval) // Фльтруємо дребезг кнопки
  {
    bool buttonState = !digitalRead(butPin); // Читаємо стан кнопки та інвертуємо його, оскільки кнопка з INPUT_PULLUP  

    if (buttonState == HIGH && previousStateButton == LOW && !longPressState) // Перевіряє чи кнопка натиснута
    {
      buttonLastPress = millis();
      previousStateButton = HIGH;
    }

    buttonPressDuration = millis() - buttonLastPress; // Віднімаємо поточний час millis() від buttonLastPress щоб дізнатися скільки часу кнопка натиснута  

    if (buttonState == HIGH && !longPressState && buttonPressDuration >= buttonLongPressDuration) // Обробка довгого натискання
    {
      longPressState = true;
      lightMode = (lightMode + 1) % 6; // Поступово збільшуємо lightMode, якщо lightMode > 5 ми його обнуляємо
      // 6 це номер останнього режиму який по дефолту повинен вимикати світлодіод, тому якщо ви змінили кількість режимів то також змініть це значення

      if(!isFirstPress) //Перевірка чи ще не було короткого натискання кнопки після sleep_mode
      {
        isFirstPress = true;
      }
    }
      
    if (buttonState == LOW && previousStateButton == HIGH) // Перевіряє чи кнопка відпущена
    {
      previousStateButton = LOW;
      longPressState = false;
      
      if (buttonPressDuration < buttonLongPressDuration) // Обробка короткого натискання
      {

        if (isFirstPress) // Якщо коротке натискання вже відбулося після виходу зі сну
        {
          EEPROM.put(EEPROM_ADDR, lightMode); // Записуємо останній вибраний режим у EEPROM
          lightMode = 6; // lightMode присвоюємо 6, це останній режим у якому світлодіод повинен бути повністю вимкненим
          sleepState = true; // Прапорець sleepState присвоюємо true, щоб мікроконтролер зайшов у сон
        }
        else
        {
          isFirstPress = true; 
        }
      }
    }
    previousButtonMillis = millis(); // Попередній час = поточний час
  }
}

// Функція перемикання режимів
void lightSwitch(){

  switch (lightMode) 
  {
    // 1 Режим (Максимальна яскравість 1 світлодіоду)
    case 0:
    analogWrite(ledPin, 255); // Cвітимо на максимальну яскравість (Споживання ~350мА)
    analogWrite(ledPin2, 0);
    break;

    // 2 Режим (Середня яскравість 1 світлодіоду)
    case 1:
    analogWrite(ledPin, 100); // Яскравість: 100 із 255, середня яскравість (Споживання ~140мА)
    analogWrite(ledPin2, 0);
    break;

    // 3 Режим (Мінімальна яскравість 1 світлодіоду)
    case 2:
    analogWrite(ledPin, 25); // Яскравість 25 із 255, мінімальна яскравість (Споживання ~40мА)
    analogWrite(ledPin2, 0);
    break;

    // 4 Режим (Максимальна яскравість 2 світлодіоду)
    case 3:
    analogWrite(ledPin, 0); 
    analogWrite(ledPin2, 255); // Cвітимо на максимальну яскравість (Споживання ~350мА)
    break;

    // 5 Режим (Середня яскравість 2 світлодіоду)
    case 4:
    analogWrite(ledPin, 0);
    analogWrite(ledPin2, 100); // Яскравість: 100 із 255, середня яскравість (Споживання ~140мА)
    break;

    // 6 Режим (Мінімальна яскравість 2 світлодіоду)
    case 5:
    analogWrite(ledPin, 0);
    analogWrite(ledPin2, 25); // Яскравість 25 із 255, мінімальна яскравість (Споживання ~40мА)
    break;

    // Стан світлодіодів по замовчуванню (Виключені)
    case 6:
    analogWrite(ledPin, 0); // Яскравість 0 із 255, світлодіод 1 виключений
    analogWrite(ledPin2, 0); // Яскравість 0 із 255, світлодіод 2 виключений
    break;
  }
}

// Обробник переривань, запускається коли мікроконтролер знаходиться у режимі сну та спрацьовує переривання INT0 на PB1
ISR(PCINT0_vect){
  lightMode = EEPROM.read(EEPROM_ADDR); // Читаємо останній режим світіння з EEPROM та присвоюєм його lightMode
  isFirstPress = false; // За замовчуванням, першого натиску на кнопку ще не було
  sleepState = false; // Прапорець sleepState виставляємо в false, тим самим забороняємо режим сну та виходимо з нього у функції sleepCheck
}

// Функція перевірки сну
void sleepCheck(){
  if(sleepState) // Якщо sleepState = true, тобто режим сну дозволено
  {
    MCUCR|= 1<<SE; // Вмикаємо можливість переходу в режим сну, те саме що sleep_enable()
    PCMSK|= 1<<PCINT2; // Вмикаємо переривання PCINT2 на 7 піні(PB2), переривання спрацьовує коли на піні змінюється рівень сигналу
    sleep_mode(); // Солодко засинаємо :)
  }
  else
  {
    MCUCR&= ~(1<<SE); // Забороняємо перехід в режим сну, те саме що sleep_disable()
    PCMSK &= ~(1 << PCINT2); // Вимикаємо PCINT2
  }
}

// Головний цикл
void loop() {
  sleepCheck(); // Викликаємо функцію перевірки сну
  buttonProcessing(); // Викликаємо функцію обробника кнопки
  lightSwitch(); // Викликаємо функцію перемикання режимів світіння
}

// Версія модифікованої прошивки: V1.0
// Усі режими стабільні, збереження в EEPROM працює
// Режим сну перевірено — 30μA в sleep_mode

// Код протестовано на ATtiny13A @1.2 MHz, BOD level - 2.7V, живлення 3.7В Li-ion (Fuses: lfuse: 2A hfuse: FB)
